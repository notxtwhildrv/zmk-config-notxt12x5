## boards/shields/notxt12x5/Kconfig.defconfig
```kconfig
if SHIELD_NOTXT12X5

config ZMK_KEYBOARD_NAME
    default "notxt12x5"

CONFIG_ZMK_BLE_EXPERIMENTAL_FEATURES=y

endif
```

## boards/shields/redox/Kconfig.defconfig
```kconfig
if SHIELD_REDOX

config ZMK_KEYBOARD_NAME
    default "redox"

config ZMK_USB
    default y
    
endif
```

## boards/shields/walletled/Kconfig.defconfig
```kconfig
if SHIELD_WALLETLED

config ZMK_KEYBOARD_NAME
    default "walletled"

config ZMK_USB
    default y
    
endif
```

## boards/shields/wallettest/Kconfig.defconfig
```kconfig
if SHIELD_WALLETTEST

config ZMK_KEYBOARD_NAME
    default "wallettest"

config ZMK_USB
    default y
    
endif
```
